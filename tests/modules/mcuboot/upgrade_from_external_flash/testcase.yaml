## tests/modules/mcuboot/upgrade_from_external_flash/testcase.yaml
```yaml
common:
  tags: mcuboot external_flash
  platform_allow:
    nrf52840dk_nrf52840
    nrf5340dk_nrf5340_cpuapp
    nrf9160dk_nrf9160_ns
tests:
  mcuboot.upgrade_from_external_flash:
    build_only: true
```
